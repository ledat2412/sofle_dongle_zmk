## boards/shields/sofle_dongle/Kconfig.defconfig
```kconfig
if SHIELD_SOFLE_DONGLE

config ZMK_KEYBOARD_NAME
    default "Sofle Dongle"

config ZMK_SPLIT
    bool
    default y

config ZMK_SPLIT_BLE
    bool
    default y

config ZMK_SPLIT_ROLE_CENTRAL
    bool
    default y

endif 
```

## boards/shields/sofle_left/Kconfig.defconfig
```kconfig
if SHIELD_SOFLE_LEFT

config ZMK_KEYBOARD_NAME
    default "Sofle Left"

config ZMK_SPLIT
    bool
    default y

config ZMK_SPLIT_BLE
    bool
    default y

config ZMK_SPLIT_BLE_ROLE_PERIPHERAL
    bool
    default y

endif 
```

## boards/shields/sofle_right/Kconfig.defconfig
```kconfig
if SHIELD_SOFLE_RIGHT

config ZMK_KEYBOARD_NAME
    default "Sofle Right"

config ZMK_SPLIT
    bool
    default y

config ZMK_SPLIT_BLE
    bool
    default y

config ZMK_SPLIT_ROLE_PERIPHERAL
    bool
    default y

endif 
```
